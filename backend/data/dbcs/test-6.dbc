VERSION "1.0"
NS_ :

BS_:
BU_: ECU
BO_ 123 MyMessage: 8 ECU
 SG_ Signal1 : 0|8@1+ (1,0) [0|255] "" ECU
