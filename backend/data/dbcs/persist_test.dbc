VERSION "1.0"
NS_ :

BS_:
BU_: ECU
BO_ 200 PersistMsg: 8 ECU
 SG_ SigA : 0|8@1+ (1,0) [0|255] "" ECU
