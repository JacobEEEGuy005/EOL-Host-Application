VERSION ""

NS_ :

BS_:

BU_: EOL_Hardware Host_PC IPC_Hardware

BO_ 256 Status_Data: 8 EOL_Hardware
 SG_ DeviceID : 0|8@1+ (1,0) [0|255] ""  Host_PC
 SG_ MessageType M : 8|8@1+ (1,0) [0|255] ""  Host_PC
 SG_ Heartbeat_Counter m1 : 16|16@1+ (1,0) [0|65535] ""  Host_PC
 SG_ ADC_A0_mV m2 : 16|16@1+ (1,0) [0|65535] "mV"  Host_PC
 SG_ ADC_A1_mV m2 : 32|16@1+ (1,0) [0|65535] "mV"  Host_PC
 SG_ ADC_A2_mV m2 : 48|16@1+ (1,0) [0|65535] "mV"  Host_PC
 SG_ ADC_A3_mV m3 : 16|16@1+ (1,0) [0|65535] "mV"  Host_PC
 SG_ I2C_DeviceCount m4 : 16|8@1+ (1,0) [0|16] ""  Host_PC
 SG_ I2C_Addr1 m4 : 24|8@1+ (1,0) [0|255] ""  Host_PC
 SG_ I2C_Addr2 m4 : 32|8@1+ (1,0) [0|255] ""  Host_PC
 SG_ I2C_Addr3 m4 : 40|8@1+ (1,0) [0|255] ""  Host_PC
 SG_ I2C_Addr4 m4 : 48|8@1+ (1,0) [0|255] ""  Host_PC
 SG_ I2C_Addr5 m4 : 56|8@1+ (1,0) [0|255] ""  Host_PC
 SG_ HardwareStatus m5 : 16|8@1+ (1,0) [0|255] ""  Host_PC
 SG_ DAC_Voltage_mV m6 : 16|16@1+ (1,0) [0|5000] "mV"  Host_PC
 SG_ Relay_State m7 : 16|8@1+ (1,0) [0|15] ""  Host_PC
 SG_ MUX_Channel m8 : 16|8@1+ (1,0) [0|7] ""  Host_PC
 SG_ MUX_Enabled m8 : 24|8@1+ (1,0) [0|1] ""  Host_PC

BO_ 272 Command: 8 Host_PC
 SG_ DeviceID : 0|8@1+ (1,0) [0|255] ""  EOL_Hardware,IPC_Hardware
 SG_ MessageType M : 8|8@1+ (1,0) [0|255] ""  EOL_Hardware,IPC_Hardware
 SG_ CMD_Relay_1 m16 : 16|1@1+ (1,0) [0|1] ""  EOL_Hardware,IPC_Hardware
 SG_ MUX_Channel m17 : 16|8@1+ (1,0) [0|7] ""  EOL_Hardware,IPC_Hardware
 SG_ MUX_Enable m17 : 24|8@1+ (1,0) [0|1] ""  EOL_Hardware,IPC_Hardware
 SG_ DAC_Voltage_mV m18 : 16|16@1+ (1,0) [0|5000] "mV"  EOL_Hardware,IPC_Hardware
 SG_ RequestIPCData m19 : 16|8@1+ (1,0) [0|255] "" Vector__XXX
 SG_ CMD_Relay_2 m16 : 17|1@1+ (1,0) [0|1] "" Vector__XXX
 SG_ CMD_Relay_3 m16 : 18|1@1+ (1,0) [0|1] "" Vector__XXX
 SG_ CMD_Relay_4 m16 : 19|1@1+ (1,0) [0|1] "" Vector__XXX
 SG_ Mctrl_Phase_I_Test_Enable m20 : 16|1@1+ (1,0) [0|1] "" Vector__XXX
 SG_ Mctrl_Set_Iq_Ref m20 : 32|16@1- (0.1,0) [-3276.7|3276.7] "A" Vector__XXX
 SG_ Mctrl_Set_Id_Ref m20 : 48|16@1- (0.1,0) [-3276.7|3276.7] "A" Vector__XXX
 SG_ Fan_Ctrl m21 : 16|1@1+ (1,0) [0|1] "" Vector__XXX
 SG_ Ext_5V_Ctrl m22 : 16|1@1+ (1,0) [0|1] "" Vector__XXX
 SG_ Test_Request m32 : 16|8@1+ (1,0) [0|255] "" Vector__XXX
 SG_ ChargerVout_SetPoint m33 : 16|16@1+ (0.01,0) [0|655.35] "V" Vector__XXX
 SG_ ChargerIout_SetPoint m33 : 32|16@1+ (0.01,0) [0|655.35] "A" Vector__XXX
 SG_ Set_ChargerIout_TrimValue m34 : 32|16@1+ (0.01,0) [0|655.35] "%" Vector__XXX

BO_ 250 IP_Status_Data: 8 IPC_Hardware
 SG_ DeviceID : 0|8@1+ (1,0) [0|255] ""  Host_PC
 SG_ MessageType M : 8|8@1+ (1,0) [0|255] ""  Host_PC
 SG_ Throttle1Voltage m101 : 16|16@1+ (1,0) [0|65535] "mV"  Host_PC
 SG_ Throttle2Voltage m101 : 32|16@1+ (1,0) [0|65535] "mV"  Host_PC
 SG_ BrakeVoltage m101 : 48|16@1+ (1,0) [0|65535] "mV"  Host_PC
 SG_ EncSineVoltage m102 : 16|16@1+ (1,0) [0|65535] "mV"  Host_PC
 SG_ EncCosineVoltage m102 : 32|16@1+ (1,0) [0|65535] "mV"  Host_PC
 SG_ Analog1Voltage m103 : 16|16@1+ (1,0) [0|65535] "mV"  Host_PC
 SG_ Analog2Voltage m103 : 32|16@1+ (1,0) [0|65535] "mV"  Host_PC
 SG_ MtrTempVoltage m103 : 48|16@1+ (1,0) [0|65535] "mV"  Host_PC
 SG_ DCBusVoltage m102 : 48|16@1+ (0.01,0) [0|655.35] "V"  Host_PC
 SG_ PhaseVCurrent m104 : 16|16@1- (0.1,0) [-3276.7|3276.7] "A"  Host_PC
 SG_ PhaseWCurrent m104 : 32|16@1- (0.1,0) [-3276.7|3276.7] "A"  Host_PC
 SG_ KeySwitchIndicator m100 : 16|1@1+ (1,0) [0|1] ""  Host_PC
 SG_ ForwardMode m100 : 17|1@1+ (1,0) [0|1] ""  Host_PC
 SG_ BoostMode m100 : 18|1@1+ (1,0) [0|1] ""  Host_PC
 SG_ GradientMode m100 : 19|1@1+ (1,0) [0|1] ""  Host_PC
 SG_ NeutralMode m100 : 20|1@1+ (1,0) [0|1] ""  Host_PC
 SG_ ReverseMode m100 : 21|1@1+ (1,0) [0|1] ""  Host_PC
 SG_ external5V m104 : 48|16@1+ (1,0) [0|65535] "mV" Vector__XXX
 SG_ IPCTestState m150 : 16|8@1+ (1,0) [0|255] "" Vector__XXX
 SG_ IPCTestEnabled m150 : 24|1@1+ (1,0) [0|1] "" Vector__XXX
 SG_ FanEnabled m105 : 16|1@1+ (1,0) [0|1] "" Vector__XXX
 SG_ FanTachGood m105 : 17|1@1+ (1,0) [0|1] "" Vector__XXX
 SG_ FanFault m105 : 18|1@1+ (1,0) [0|1] "" Vector__XXX
 SG_ InverterTemperature m106 : 16|16@1- (0.01,0) [-327.67|327.67] "degC" Vector__XXX
 SG_ MotorTemperature m106 : 48|16@1- (0.01,0) [-327.67|327.67] "degC" Vector__XXX
 SG_ Enable_ACInputRelay m107 : 16|1@1+ (1,0) [0|1] "" Vector__XXX
 SG_ Enable_FAN m107 : 17|1@1+ (1,0) [0|1] "" Vector__XXX
 SG_ Enable_PFC m107 : 18|1@1+ (1,0) [0|1] "" Vector__XXX
 SG_ Disable_HV_GDriver m107 : 19|1@1+ (1,0) [0|1] "" Vector__XXX
 SG_ Plug_Pilot m107 : 20|1@1+ (1,0) [0|1] "" Vector__XXX
 SG_ Plug_Pilot_Filtered m107 : 21|1@1+ (1,0) [0|1] "" Vector__XXX
 SG_ PFC_PGood m107 : 22|1@1+ (1,0) [0|1] "" Vector__XXX
 SG_ PFC_PGood_Filtered m107 : 23|1@1+ (1,0) [0|1] "" Vector__XXX
 SG_ Fan_Tach_Good m107 : 24|1@1+ (1,0) [0|1] "" Vector__XXX
 SG_ AC_Detect m107 : 25|1@1+ (1,0) [0|1] "" Vector__XXX
 SG_ AC_Good m107 : 26|1@1+ (1,0) [0|1] "" Vector__XXX
 SG_ ChargerFaultNow m107 : 32|8@1+ (1,0) [0|255] "" Vector__XXX
 SG_ ChargerFaultPrev m107 : 40|8@1+ (1,0) [0|255] "" Vector__XXX
 SG_ ChargerTestState m107 : 48|8@1+ (1,0) [0|255] "" Vector__XXX
 SG_ PCMC_Flag m107 : 56|8@1+ (1,0) [0|1] "" Vector__XXX
 SG_ ACPWMFaultNow m108 : 16|8@1+ (1,0) [0|255] "" Vector__XXX
 SG_ ACPWMFaultPrev m108 : 24|8@1+ (1,0) [0|255] "" Vector__XXX
 SG_ ACPWM_Frequency m108 : 32|16@1+ (1,0) [0|65535] "Hz" Vector__XXX
 SG_ ACPWM_Duty m108 : 48|16@1+ (0.01,0) [0|100] "%" Vector__XXX
 SG_ ACFaultNow m109 : 16|8@1+ (1,0) [0|0] "" Vector__XXX
 SG_ ACFaultPrev m109 : 24|8@1+ (1,0) [0|0] "" Vector__XXX
 SG_ AC_VoltageRMS m109 : 32|16@1+ (0.01,0) [0|655.35] "V" Vector__XXX
 SG_ AC_LineFrequency m109 : 48|8@1+ (0.01,0) [0|655.35] "Hz" Vector__XXX
 SG_ ChargerVout m110 : 16|16@1+ (0.01,0) [0|655.35] "V" Vector__XXX
 SG_ ChargerIout m110 : 32|16@1+ (0.01,0) [0|655.35] "A" Vector__XXX
 SG_ RectifierTemperature m110 : 48|16@1- (0.01,0) [-327.67|327.67] "degC" Vector__XXX
 SG_ ChargerIout_TrimValue m111 : 32|16@1+ (0.01,0) [0|655.35] "%" Vector__XXX

BO_ 3221225472 VECTOR__INDEPENDENT_SIG_MSG: 0 Vector__XXX
 SG_ NewSignal_0020 : 0|8@1+ (1,0) [0|0] "" Vector__XXX
 SG_ PhaseWCurrentFSR m114 : 32|16@1+ (0.1,0) [-3276.7|3276.7] "A" Vector__XXX
 SG_ PhaseVCurrentFSR m114 : 16|16@1+ (0.1,0) [-3276.7|3276.7] "A" Vector__XXX
 SG_ DCBusVoltageFSR m112 : 48|16@1+ (0.01,0) [0|655.35] "V" Vector__XXX
 SG_ MtrTempFSR m113 : 48|16@1+ (0.01,0) [0|655.35] "V" Vector__XXX
 SG_ Analog2FSR m113 : 32|16@1+ (0.01,0) [0|655.35] "V" Vector__XXX
 SG_ Analog1FSR m113 : 16|16@1+ (0.01,0) [0|655.35] "V" Vector__XXX
 SG_ EncCosineFSR m112 : 32|16@1+ (0.01,0) [0|655.35] "V" Vector__XXX
 SG_ EncSineFSR m112 : 16|16@1+ (0.01,0) [0|655.35] "V" Vector__XXX
 SG_ BrakeFSR m111 : 48|16@1+ (0.01,0) [0|655.35] "V" Vector__XXX
 SG_ Throttle2FSR m111 : 32|16@1+ (0.01,0) [0|655.35] "V" Vector__XXX
 SG_ Throttle1FSR m111 : 16|16@1+ (0.01,0) [0|655.35] "V" Vector__XXX
 SG_ RectifierTemperature m106 : 32|16@1- (0.01,0) [-327.67|327.67] "degC" Vector__XXX
 SG_ NewSignal_0024 : 0|8@1+ (1,0) [0|0] "" Vector__XXX
 SG_ NewSignal_0031 : 0|8@1+ (1,0) [0|0] "" Vector__XXX
 SG_ Charger_SignalState m107 : 16|16@1+ (1,0) [0|65535] "" Vector__XXX

CM_ BU_ EOL_Hardware "EOL Test Hardware Device";
CM_ BU_ Host_PC "Host Computer for Test Control";
CM_ BU_ IPC_Hardware "Integrated Power Converter - Device Under Test";
CM_ BO_ 256 "Status and data messages from EOL Hardware to Host PC (MessageType determines content)";
CM_ SG_ 256 DeviceID "Device ID (0x01 for EOL Hardware)";
CM_ SG_ 256 MessageType "Message type identifier (multiplexor for payload interpretation)";
CM_ SG_ 256 Heartbeat_Counter "Heartbeat counter (increments every heartbeat)";
CM_ SG_ 256 ADC_A0_mV "ADC channel A0 reading in millivolts";
CM_ SG_ 256 ADC_A1_mV "ADC channel A1 reading in millivolts";
CM_ SG_ 256 ADC_A2_mV "ADC channel A2 reading in millivolts";
CM_ SG_ 256 ADC_A3_mV "ADC channel A3 reading in millivolts";
CM_ SG_ 256 I2C_DeviceCount "Number of I2C devices found on bus";
CM_ SG_ 256 I2C_Addr1 "I2C device address at index 0 (7-bit address)";
CM_ SG_ 256 I2C_Addr2 "I2C device address at index 1 (7-bit address)";
CM_ SG_ 256 I2C_Addr3 "I2C device address at index 2 (7-bit address)";
CM_ SG_ 256 I2C_Addr4 "I2C device address at index 3 (7-bit address)";
CM_ SG_ 256 I2C_Addr5 "I2C device address at index 4 (7-bit address)";
CM_ SG_ 256 HardwareStatus "Hardware status flags (bit 0=ADC available, bit 1=DAC available)";
CM_ SG_ 256 DAC_Voltage_mV "Current DAC output voltage in millivolts";
CM_ SG_ 256 Relay_State "Relay state bitmap (bit 0=R1, bit 1=R2, bit 2=R3, bit 3=R4)";
CM_ SG_ 256 MUX_Channel "Currently selected MUX channel (0-7 for Y0-Y7)";
CM_ SG_ 256 MUX_Enabled "MUX enable state (1=enabled, 0=disabled)";
CM_ BO_ 272 "Command messages from Host PC to EOL Hardware (MessageType determines command)";
CM_ SG_ 272 DeviceID "Target device ID (0x01 for EOL Hardware)";
CM_ SG_ 272 MessageType "Command type identifier (multiplexor for command parameters)";
CM_ SG_ 272 CMD_Relay_1 "0 = Relay Off, 1 = Relay On";
CM_ SG_ 272 MUX_Channel "MUX channel to select (0-7 for Y0-Y7)";
CM_ SG_ 272 MUX_Enable "MUX enable command (1=enable, 0=disable)";
CM_ SG_ 272 DAC_Voltage_mV "Desired DAC output voltage in millivolts (0-5000)";
CM_ SG_ 272 RequestIPCData "Request Data from IPC";
CM_ SG_ 272 CMD_Relay_2 "0 = Relay Off, 1 = Relay On";
CM_ SG_ 272 CMD_Relay_3 "0 = Relay Off, 1 = Relay On";
CM_ SG_ 272 CMD_Relay_4 "0 = Relay Off, 1 = Relay On";
CM_ SG_ 272 Mctrl_Phase_I_Test_Enable "Set Enable Flag to start Phase Current Calibration";
CM_ SG_ 272 Mctrl_Set_Iq_Ref "Set Quadrature Axis Current Reference for Phase Current Testing";
CM_ SG_ 272 Mctrl_Set_Id_Ref "Set Direct Axis Current Reference for Phase Current Testing";
CM_ SG_ 272 Fan_Ctrl "Command to enable or disable Fan";
CM_ SG_ 272 Ext_5V_Ctrl "Command to enable or disable External 5V ";
CM_ BO_ 250 "Status and data messages from IPC Hardware to Host PC (MessageType determines content)";
CM_ SG_ 250 DeviceID "Device ID (0x03 for IPC Hardware)";
CM_ SG_ 250 MessageType "Message type identifier (multiplexor for payload interpretation)";
CM_ SG_ 250 Throttle1Voltage "Throttle 1 Voltage";
CM_ SG_ 250 Throttle2Voltage "Throttle 2 Voltage";
CM_ SG_ 250 BrakeVoltage "Brake Voltage ";
CM_ SG_ 250 EncSineVoltage "Encoder Sine Voltage";
CM_ SG_ 250 EncCosineVoltage "Encoder Cosine Voltage";
CM_ SG_ 250 Analog1Voltage "Analog 1 Voltage";
CM_ SG_ 250 Analog2Voltage "Analog 2 Voltage";
CM_ SG_ 250 MtrTempVoltage "Motor Temperautre Sensor Voltage";
CM_ SG_ 250 DCBusVoltage "DC Bus Voltage";
CM_ SG_ 250 PhaseVCurrent "Phase V Current";
CM_ SG_ 250 PhaseWCurrent "Phase W Current";
CM_ SG_ 250 KeySwitchIndicator "Key Switch Indicator Input";
CM_ SG_ 250 ForwardMode "Forward Mode Switch Input";
CM_ SG_ 250 BoostMode "Boost Mode Switch Input";
CM_ SG_ 250 GradientMode "Gradient Mode Switch Input";
CM_ SG_ 250 NeutralMode "Neutral Mode Switch Input";
CM_ SG_ 250 ReverseMode "Reverse Mode Switch Input";
CM_ SG_ 250 external5V "external 5V Rail Voltage ";
CM_ SG_ 250 IPCTestState "Test Statemachine Status";
CM_ SG_ 250 IPCTestEnabled "Flag for Check if Test Mode is enabled";
CM_ SG_ 250 FanEnabled "Flag to check if Fan control is enabled";
CM_ SG_ 250 FanTachGood "Flag to check if fan is acutally spinning.";
CM_ SG_ 250 FanFault "Flag to check if fan control has fault";
CM_ SG_ 250 InverterTemperature "Inverter Module Temperature";
CM_ SG_ 250 MotorTemperature "Motor Temperature";
CM_ SG_ 3221225472 PhaseWCurrentFSR "Full Scale Reading of Phase W Current Sensor";
CM_ SG_ 3221225472 PhaseVCurrentFSR "Full Scale Reading of Phase V Current Sensor";
CM_ SG_ 3221225472 DCBusVoltageFSR "Full Scale Reading of DC Bus Voltage Sensor";
CM_ SG_ 3221225472 MtrTempFSR "Full Scale Reading of Motor Temperature Sensor Input";
CM_ SG_ 3221225472 Analog2FSR "Full Scale Reading of Analog 2 Input";
CM_ SG_ 3221225472 Analog1FSR "Full Scale Reading of Analog 1 Input";
CM_ SG_ 3221225472 EncCosineFSR "Full Scale Reading of Cosine Input";
CM_ SG_ 3221225472 EncSineFSR "Full Scale Reading of Encoder Sin Input";
CM_ SG_ 3221225472 BrakeFSR "Full Scale Reading of Brake Input";
CM_ SG_ 3221225472 Throttle2FSR "Full Scale Reading of Throttle 2 Input";
CM_ SG_ 3221225472 Throttle1FSR "Full Scale Reading of Throttle 1 Input";
CM_ SG_ 3221225472 RectifierTemperature "Rectifier Module Temperature";
CM_ SG_ 3221225472 Charger_SignalState "2 Byte Status of various Digital Signal States for Charger";
BA_DEF_  "BusType" STRING ;
BA_DEF_ BO_  "GenMsgCycleTime" INT 0 10000;
BA_DEF_DEF_  "BusType" "CAN";
BA_DEF_DEF_  "GenMsgCycleTime" 0;
BA_ "GenMsgCycleTime" BO_ 256 400;
BA_ "GenMsgCycleTime" BO_ 250 100;
VAL_ 256 MessageType 1 "Heartbeat" 2 "ADC_Data_A0_A1_A2" 3 "ADC_A3" 4 "I2C_Scan" 5 "Status" 6 "DAC_Voltage" 7 "Relay_State" 8 "MUX_State" ;
VAL_ 256 HardwareStatus 0 "None" 1 "ADC_Available" 2 "DAC_Available" 3 "ADC_DAC_Available" ;
VAL_ 256 MUX_Enabled 0 "Disabled" 1 "Enabled" ;
VAL_ 272 MessageType 16 "CMD_SetRelay" 17 "CMD_SetMUX" 18 "CMD_SetDAC" 19 "CMD_Req_IPC_Data" ;
VAL_ 272 MUX_Enable 0 "Disable" 1 "Enable" ;
VAL_ 272 RequestIPCData 111 "AnalogParams1" 112 "AnalogParams2" 113 "AnalogParams3" 114 "AnalogParams4" ;
VAL_ 272 Fan_Ctrl 0 "Disable" 1 "Enable" ;
VAL_ 272 Ext_5V_Ctrl 0 "Disable" 1 "Enable" ;
VAL_ 250 MessageType 100 "DigSig1" 101 "AnalogValues1" 102 "AnalogValues2" 103 "AnalogValues3" 104 "AnalogValues4" 111 "AnalogParams1" 112 "AnalogParams2" 113 "AnalogParams3" 114 "AnalogParams4" ;
VAL_ 250 KeySwitchIndicator 0 "Off" 1 "On" ;
VAL_ 250 ForwardMode 0 "Off" 1 "On" ;
VAL_ 250 BoostMode 0 "Off" 1 "On" ;
VAL_ 250 GradientMode 0 "Off" 1 "On" ;
VAL_ 250 NeutralMode 0 "Off" 1 "On" ;
VAL_ 250 ReverseMode 0 "Off" 1 "On" ;
VAL_ 250 IPCTestState 0 "TEST_MODE_DISABLED" 1 "TEST_INIT" 2 "TEST_MCTRL" 3 "TEST_MCTRL_RUNNING" 4 "TEST_PSFB" 5 "TEST_PSFB_RUNNING" 6 "TEST_STOP" ;
VAL_ 250 IPCTestEnabled 0 "FALSE" 1 "TRUE" ;
VAL_ 250 FanEnabled 0 "FALSE" 1 "TRUE" ;
VAL_ 250 FanTachGood 0 "FALSE" 1 "TRUE" ;
VAL_ 250 FanFault 0 "FALSE" 1 "TRUE" ;
